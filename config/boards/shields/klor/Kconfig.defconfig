## config/boards/shields/klor/Kconfig.defconfig
```kconfig
# if SHIELD_KLOR_DONGLE
#
#     config ZMK_KEYBOARD_NAME
#         default "KLOR"
#
#     config ZMK_SPLIT_BLE_ROLE_CENTRAL
#         default y
#
#     config ZMK_SPLIT
#         default y
#     #config ZMK_SPLIT_BLE_PERIPHERAL_COUNT
#     #    default 2
#
#      # Set this to ZMK_SPLIT_BLE_CENTRAL_PERIPHERALS + your desired number of BT profiles (default is 5)
#      config BT_MAX_CONN
#          default 6
#
#      # Set this to the same number as BT_MAX_CONN
#      config BT_MAX_PAIRED
#          default 6
#
# endif # DONGLE
#
if SHIELD_KLOR_DONGLE

config ZMK_KEYBOARD_NAME
    default "KLOR"
    
config ZMK_SPLIT_BLE_ROLE_CENTRAL
    default y

config ZMK_SPLIT_BLE_CENTRAL_PERIPHERALS
    default 2

# Allow enough simultaneous connections for:
# - 2 split peripherals (halves)
# - optional BLE host connection (when not using USB output)
config BT_MAX_CONN
	default 4

# Allow pairing slots for halves + a few host profiles.
config BT_MAX_PAIRED
    default 6

config ZMK_USB
    default y

config ZMK_SPLIT
	default y

config ZMK_BLE
    default y

endif

if SHIELD_KLOR_LEFT || SHIELD_KLOR_RIGHT

config ZMK_SPLIT
	default y

config ZMK_BLE
    default y

endif
```
